## arch/riscv/Kconfig
```kconfig
menu "RISC-V architecture"
	depends on RISCV

config SYS_ARCH
	default "riscv"

choice
	prompt "Target select"
	optional

config TARGET_AX25_AE350
	bool "Support ax25-ae350"

config TARGET_QEMU_VIRT
	bool "Support QEMU Virt Board"

config TARGET_U540_C000
	bool "Support ux540-c000"

endchoice

source "board/AndesTech/ax25-ae350/Kconfig"
source "board/emulation/qemu-riscv/Kconfig"
source "board/sifive/hifive_unleashed/Kconfig"

choice
	prompt "CPU selection"
	default CPU_RISCV_32

config CPU_RISCV_32
	bool "RISC-V 32-bit"
	select 32BIT
	help
	  Choose this option to build an U-Boot for RISCV32 architecture.

config CPU_RISCV_64
	bool "RISC-V 64-bit"
	select 64BIT
	help
	  Choose this option to build an U-Boot for RISCV64 architecture.

endchoice

config 32BIT
	bool

config 64BIT
	bool

endmenu
```

## board/sifive/hifive_unleashed/Kconfig
```kconfig
if TARGET_HIFIVE_UNLEASHED

config SYS_CPU
	default "u540-c000"

config SYS_BOARD
	default "hifive_unleashed"

config SYS_VENDOR
	default "sifive"

config SYS_SOC
	default "u540-c000"

config SYS_CONFIG_NAME
	default "hifive_unleashed"

config ENV_SIZE
	default 0x2000 if ENV_IS_IN_SPI_FLASH

config ENV_OFFSET
	default 0x140000 if ENV_IS_IN_SPI_FLASH

endif
```

## configs/hifive_unleashed_defconfig
```kconfig
CONFIG_RISCV=y
CONFIG_SYS_TEXT_BASE=0x80000000
CONFIG_TARGET_HIFIVE_UNLEASHED=y
CONFIG_CPU_RISCV_64=y
CONFIG_NR_DRAM_BANKS=1
CONFIG_BOOTDELAY=3
CONFIG_SYS_PROMPT="hifive_unleashed => "
CONFIG_OF_BOARD=y
CONFIG_DEFAULT_DEVICE_TREE="hifive_unleashed"
```

## configs/hikey960_defconfig
```kconfig
CONFIG_ARM=y
CONFIG_TARGET_HIKEY960=y
CONFIG_SYS_TEXT_BASE=0x1ac98000
CONFIG_SYS_MALLOC_F_LEN=0x2000
CONFIG_DEBUG_UART_BASE=0xfff32000
CONFIG_DEBUG_UART_CLOCK=0
CONFIG_DEBUG_UART_SKIP_INIT=y
CONFIG_DEBUG_UART=y
CONFIG_DEBUG_UART_PL011=y
CONFIG_DEBUG_UART_ANNOUNCE=y
CONFIG_NR_DRAM_BANKS=9
CONFIG_IDENT_STRING="\nHikey960"
# CONFIG_DISPLAY_CPUINFO is not set
# CONFIG_DISPLAY_BOARDINFO is not set
CONFIG_BOOTDELAY=10
CONFIG_SYS_PROMPT="U-Boot => "
CONFIG_USE_BOOTARGS=y
CONFIG_BOOTARGS="console=ttyAMA6,115200n8 root=/dev/mmcblk0p9 rw"
CONFIG_MISC_INIT_R=y
CONFIG_BOARD_EARLY_INIT_F=y
CONFIG_DEFAULT_DEVICE_TREE="hi3660-hikey960"
CONFIG_OF_LIBFDT_OVERLAY=y
CONFIG_CONS_INDEX=7
```
